## robot-server/Config.in
```kconfig
config BR2_PACKAGE_PYTHON_OPENTRONS_ROBOT_SERVER
  bool "python-opentrons-robot-server"
  depends on BR2_PACKAGE_PYTHON3
  select BR2_PACKAGE_PYTHON_OPENTRONS_API # runtime
  select BR2_PACKAGE_PYTHON_OPENTRONS_SHARED_DATA # runtime
  select BR2_PACKAGE_PYTHON_OPENTRONS_SERVER_UTILS # runtime
  select BR2_PACKAGE_PYTHON_ANYIO # runtime
  select BR2_PACKAGE_PYTHON_FASTAPI # runtime
  select BR2_PACKAGE_PYTHON_DOTENV # runtime
  select BR2_PACKAGE_PYTHON_MULTIPART # runtime
  select BR2_PACKAGE_PYTHON_PYDANTIC # runtime
  select BR2_PACKAGE_PYTHON_SQLALCHEMY # runtime
  select BR2_PACKAGE_PYTHON_TYPING_EXTENSIONS # runtime
  select BR2_PACKAGE_PYTHON_UVICORN # runtime
  select BR2_PACKAGE_PYTHON_WSPROTO # runtime
  select BR2_PACKAGE_PYTHON_PAHO_MQTT # runtime
  select BR2_PACKAGE_PYTHON_PYDANTIC_SETTINGS # runtime

  help
    Opentrons HTTP server. Controls an OT-2 robot.

    https://opentrons.com
```
